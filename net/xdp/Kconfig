## net/xdp/Kconfig
```kconfig
config XDP_SOCKETS
	bool "XDP sockets"
	depends on BPF_SYSCALL
	default n
	help
	  XDP sockets allows a channel between XDP programs and
	  userspace applications.

config XDP_LUA
	bool "XDP LUA"
	depends on BPF_SYSCALL && LUNATIK
	default n
	help
	  Support for Lua scripts inside XDP
```
